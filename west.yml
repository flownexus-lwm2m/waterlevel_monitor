## west.yml
```yaml
manifest:
  self:
    path: waterlevel_monitor

  remotes:
    - name: nrfconnect
      url-base: https://github.com/nrfconnect

  projects:
    - name: sdk-nrf
      path: nrf
      remote: nrfconnect
      revision: main
      import:
        # Do not clone particular large packages that are not required.
        name-blocklist:
          - openthread
          - matter
```
